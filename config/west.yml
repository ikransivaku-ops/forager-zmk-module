## config/west.yml
```yaml
manifest:
  remotes:
    - name: zmkfirmware
      url-base: https://github.com/zmkfirmware
    - name: ikransivaku-ops
      url-base: https://github.com/ikransivaku-ops

manifest:
  remotes:
    - name: zmkfirmware
      url-base: https://github.com/zmkfirmware

    - name: ikransivaku-ops
      url-base: https://github.com/ikransivaku-ops

    - name: caksoylar
      url-base: https://github.com/caksoylar

  projects:
    - name: zmk
      remote: zmkfirmware
      revision: main
      import: app/west.yml

    - name: forager-zmk-module
      remote: ikransivaku-ops
      revision: main

    - name: zmk-rgbled-widget
      remote: caksoylar
      revision: main

  self:
    path: config
```
